## linux/raspberrypi400_aarch64_efi_defconfig
```kconfig
CONFIG_SYSVIPC=y
CONFIG_BPF_SYSCALL=y
CONFIG_BPF_JIT=y
CONFIG_BPF_JIT_ALWAYS_ON=y
CONFIG_BPF_PRELOAD=y
CONFIG_IKCONFIG=y
CONFIG_IKCONFIG_PROC=y
CONFIG_IKHEADERS=y
CONFIG_CGROUPS=y
CONFIG_CGROUP_SCHED=y
CONFIG_CFS_BANDWIDTH=y
CONFIG_USER_NS=y
CONFIG_SMP=y
CONFIG_ARM_PSCI=y
CONFIG_ARCH_BCM=y
CONFIG_ARCH_BCM2835=y
CONFIG_PINCTRL_BCM2835=y
CONFIG_EFI=y
CONFIG_EFI_STUB=y
CONFIG_KPROBES=y
# CONFIG_GCC_PLUGINS is not set
CONFIG_NET=y
CONFIG_PACKET=y
CONFIG_UNIX=y
CONFIG_INET=y
CONFIG_NETFILTER=y
CONFIG_IP_NF_IPTABLES=y
CONFIG_NET_SCHED=y
CONFIG_NET_SCH_FQ_CODEL=y
CONFIG_NET_CLS_BPF=y
CONFIG_CFG80211=y
CONFIG_CFG80211_WEXT=y
CONFIG_MAC80211=y
CONFIG_PCI=y
CONFIG_PCI_HOST_GENERIC=y
CONFIG_PCIE_BRCMSTB=y
CONFIG_DEVTMPFS=y
CONFIG_DEVTMPFS_MOUNT=y
CONFIG_VIRTIO_BLK=y
CONFIG_BLK_DEV_SD=y
CONFIG_SCSI_VIRTIO=y
CONFIG_NETDEVICES=y
CONFIG_VIRTIO_NET=y
CONFIG_BCMGENET=y
CONFIG_BRCMFMAC=y
CONFIG_INPUT_EVDEV=y
CONFIG_SERIAL_AMBA_PL011=y
CONFIG_SERIAL_AMBA_PL011_CONSOLE=y
CONFIG_VIRTIO_CONSOLE=y
CONFIG_HW_RANDOM_VIRTIO=y
CONFIG_HW_RANDOM_IPROC=y
CONFIG_TCG_TPM=y
CONFIG_TCG_TPM2_HMAC=y
CONFIG_TCG_TIS=y
CONFIG_TCG_TIS_SPI=y
CONFIG_TCG_TIS_SPI_CR50=y
CONFIG_TCG_TIS_I2C=y
CONFIG_TCG_TIS_I2C_CR50=y
CONFIG_TCG_TIS_I2C_ATMEL=y
CONFIG_TCG_TIS_I2C_INFINEON=y
CONFIG_TCG_TIS_I2C_NUVOTON=y
CONFIG_TCG_CRB=y
CONFIG_TCG_VTPM_PROXY=y
CONFIG_TCG_TIS_ST33ZP24_I2C=y
CONFIG_SPI=y
CONFIG_SPI_BCM2835=y
CONFIG_SPI_BCM2835AUX=y
CONFIG_SPI_SPIDEV=y
CONFIG_I2C=y
CONFIG_I2C_CHARDEV=y
CONFIG_I2C_BCM2835=y
CONFIG_GPIOLIB=y
CONFIG_GPIO_BCM_VIRT=y
CONFIG_GPIO_RASPBERRYPI_EXP=y
CONFIG_MEDIA_SUPPORT=y
CONFIG_DRM=y
CONFIG_DRM_SIMPLEDRM=y
CONFIG_DRM_VC4=y
CONFIG_DRM_VIRTIO_GPU=y
CONFIG_FB=y
CONFIG_SYSFB_SIMPLEFB=y
CONFIG_SOUND=y
CONFIG_SND=y
CONFIG_USB=y
CONFIG_USB_XHCI_HCD=y
CONFIG_USB_XHCI_PCI=y
CONFIG_USB_EHCI_HCD=y
CONFIG_USB_STORAGE=y
CONFIG_MMC=y
CONFIG_MMC_SDHCI=y
CONFIG_MMC_SDHCI_PLTFM=y
CONFIG_MMC_BCM2835=y
CONFIG_MMC_SDHCI_IPROC=y
CONFIG_RTC_CLASS=y
CONFIG_RTC_DRV_PL031=y
CONFIG_VIRTIO_PCI=y
CONFIG_VIRTIO_BALLOON=y
CONFIG_VIRTIO_INPUT=y
CONFIG_VIRTIO_MMIO=y
CONFIG_VIRTIO_MMIO_CMDLINE_DEVICES=y
CONFIG_THERMAL=y
CONFIG_BCM2835_THERMAL=y
CONFIG_BCM2835_WDT=y
CONFIG_MAILBOX=y
CONFIG_BCM2835_MBOX=y
CONFIG_RASPBERRYPI_FIRMWARE=y
CONFIG_RASPBERRYPI_POWER=y
CONFIG_CLK_RASPBERRYPI=y
CONFIG_RASPBERRYPI_CPUFREQ=y
CONFIG_REGULATOR=y
CONFIG_REGULATOR_FIXED_VOLTAGE=y
CONFIG_REGULATOR_GPIO=y
CONFIG_POWER_RESET=y
CONFIG_EXT4_FS=y
CONFIG_AUTOFS_FS=y
CONFIG_FUSE_FS=y
CONFIG_VFAT_FS=y
CONFIG_FAT_DEFAULT_UTF8=y
CONFIG_TMPFS_POSIX_ACL=y
CONFIG_SQUASHFS=y
CONFIG_NLS_CODEPAGE_437=y
CONFIG_NLS_ISO8859_1=y
CONFIG_TRUSTED_KEYS=y
CONFIG_ENCRYPTED_KEYS=y
CONFIG_USER_DECRYPTED_DATA=y
CONFIG_KEY_DH_OPERATIONS=y
CONFIG_SECURITY=y
CONFIG_PKCS8_PRIVATE_KEY_PARSER=y
CONFIG_DEBUG_KERNEL=y
CONFIG_DEBUG_INFO_DWARF5=y
CONFIG_READABLE_ASM=y
CONFIG_DEBUG_FS=y
CONFIG_BOOTTIME_TRACING=y
CONFIG_FUNCTION_TRACER=y
CONFIG_FUNCTION_GRAPH_RETVAL=y
CONFIG_FPROBE=y
CONFIG_FTRACE_SYSCALLS=y
CONFIG_HIST_TRIGGERS=y
```

## package/bootc/Config.in
```kconfig
config BR2_PACKAGE_BOOTC
	bool "bootc"
	depends on BR2_PACKAGE_HOST_RUSTC_ARCH_SUPPORTS
	depends on BR2_INIT_SYSTEMD
	depends on BR2_PACKAGE_LIBGPG_ERROR_ARCH_SUPPORTS # libostree
	depends on BR2_TOOLCHAIN_HAS_THREADS # libostree, composefs
	depends on BR2_USE_WCHAR # libostree
	depends on BR2_USE_MMU # libostree, composefs
	depends on !BR2_STATIC_LIBS # libostree, composefs
	depends on !BR2_TOOLCHAIN_USES_MUSL # libostree
	depends on BR2_TOOLCHAIN_HEADERS_AT_LEAST_5_8 # libostree
	select BR2_PACKAGE_COMPOSEFS
	select BR2_PACKAGE_LIBOSTREE
	select BR2_PACKAGE_OPENSSL
	select BR2_PACKAGE_ZSTD
	help
	  bootc transactionally fetches OCI containers as a bootable
	  host system. This package provides the bootc binary, its
	  systemd units and dracut module.

	  https://github.com/bootc-dev/bootc

comment "bootc needs systemd and a uClibc or glibc toolchain w/ threads, dynamic library, wchar, headers >= 5.8"
	depends on BR2_PACKAGE_HOST_RUSTC_ARCH_SUPPORTS
	depends on BR2_PACKAGE_LIBGPG_ERROR_ARCH_SUPPORTS
	depends on BR2_USE_MMU
	depends on !BR2_INIT_SYSTEMD || !BR2_TOOLCHAIN_HAS_THREADS \
		|| BR2_STATIC_LIBS || !BR2_USE_WCHAR || BR2_TOOLCHAIN_USES_MUSL \
		|| !BR2_TOOLCHAIN_HEADERS_AT_LEAST_5_8
```

## package/keygcbench/Config.in
```kconfig
config BR2_PACKAGE_KEYGCBENCH
	bool "keygcbench"
	depends on BR2_LINUX_KERNEL
	depends on BR2_TOOLCHAIN_HAS_SYNC_4 # libbpf
	depends on BR2_TOOLCHAIN_HAS_THREADS # libbpf
	depends on BR2_TOOLCHAIN_HEADERS_AT_LEAST_4_13 # libbpf
	depends on !BR2_STATIC_LIBS # libbpf
	depends on BR2_USE_MMU
	depends on BR2_USE_WCHAR # libbpf
	select BR2_LINUX_KERNEL_NEEDS_HOST_LIBELF
	select BR2_LINUX_KERNEL_NEEDS_HOST_PAHOLE
	select BR2_PACKAGE_HOST_PKGCONF
	select BR2_PACKAGE_LIBBPF
	select BR2_PACKAGE_OPENSSL
	help
	  Benchmark key garbage collection latency and competing bound
	  workqueue latency using an eBPF probe.

comment "keygcbench needs a Linux kernel and a toolchain w/ wchar, dynamic library, threads, headers >= 4.13"
	depends on BR2_USE_MMU
	depends on BR2_TOOLCHAIN_HAS_SYNC_4
	depends on !BR2_LINUX_KERNEL || !BR2_USE_WCHAR || BR2_STATIC_LIBS \
		|| !BR2_TOOLCHAIN_HAS_THREADS \
		|| !BR2_TOOLCHAIN_HEADERS_AT_LEAST_4_13
```

## package/rpi-uefi/Config.in
```kconfig
config BR2_PACKAGE_RPI_UEFI
	bool "rpi-uefi"
	depends on BR2_aarch64
	help
	  Prebuilt Raspberry Pi UEFI firmware images from pftf (EDK2).

	  Installs RPi3 and RPi4/400 firmware sets under
	  images/rpi-uefi/ for SD-card packaging (RPI_EFI.fd, GPU
	  firmware, config.txt).

	  https://github.com/pftf/RPi3
	  https://github.com/pftf/RPi4
```

## package/rpi400_bcm43456_firmware/Config.in
```kconfig
config BR2_PACKAGE_RPI400_BCM43456_FIRMWARE
	bool "rpi400 BCM43456 Wi-Fi firmware"
	help
	  Install the BCM43456 brcmfmac firmware files needed by Raspberry Pi 400
	  boards, including the board-specific firmware symlinks requested by the
	  kernel.
```

## package/toolbx/Config.in
```kconfig
config BR2_PACKAGE_TOOLBX
	bool "toolbx"
	depends on BR2_x86_64 || BR2_aarch64
	depends on BR2_INIT_SYSTEMD
	depends on BR2_USE_MMU  # podman
	depends on BR2_PACKAGE_HOST_GO_TARGET_ARCH_SUPPORTS  # host-go
	depends on BR2_PACKAGE_HOST_GO_TARGET_CGO_LINKING_SUPPORTS
	depends on BR2_PACKAGE_HOST_RUSTC_TARGET_ARCH_SUPPORTS  # podman
	depends on BR2_PACKAGE_LIBGPG_ERROR_ARCH_SUPPORTS  # podman
	depends on BR2_PACKAGE_LIBSECCOMP_ARCH_SUPPORTS  # podman
	depends on BR2_TOOLCHAIN_HEADERS_AT_LEAST_4_14  # podman
	depends on BR2_TOOLCHAIN_HAS_THREADS  # podman
	depends on BR2_USE_WCHAR  # podman
	depends on !BR2_TOOLCHAIN_USES_UCLIBC
	depends on !BR2_STATIC_LIBS
	select BR2_PACKAGE_HOST_GO
	select BR2_PACKAGE_PODMAN
	help
	  Toolbx provides interactive command-line environments for
	  development and troubleshooting without installing software on
	  the host. It is built on Podman and standard OCI technologies.

	  https://containertoolbx.org/

comment "toolbx needs systemd and a glibc/musl toolchain w/ headers >= 4.14, threads, wchar, dynamic library"
	depends on BR2_x86_64 || BR2_aarch64
	depends on BR2_PACKAGE_HOST_GO_TARGET_ARCH_SUPPORTS
	depends on BR2_PACKAGE_HOST_GO_TARGET_CGO_LINKING_SUPPORTS
	depends on BR2_PACKAGE_HOST_RUSTC_TARGET_ARCH_SUPPORTS
	depends on BR2_PACKAGE_LIBGPG_ERROR_ARCH_SUPPORTS
	depends on BR2_PACKAGE_LIBSECCOMP_ARCH_SUPPORTS
	depends on BR2_USE_MMU
	depends on !BR2_INIT_SYSTEMD || \
		!BR2_TOOLCHAIN_HEADERS_AT_LEAST_4_14 || \
		!BR2_TOOLCHAIN_HAS_THREADS || !BR2_USE_WCHAR || \
		BR2_TOOLCHAIN_USES_UCLIBC || BR2_STATIC_LIBS
```

## package/tpm2sh/Config.in
```kconfig
config BR2_PACKAGE_TPM2SH
	bool "tpm2sh"
	depends on BR2_PACKAGE_HOST_RUSTC_TARGET_ARCH_SUPPORTS
	select BR2_PACKAGE_HOST_RUSTC
	select BR2_PACKAGE_HOST_PKGCONF
	select BR2_PACKAGE_OPENSSL
	select BR2_PACKAGE_OPENSSL_FORCE_LIBOPENSSL
	help
	  TPM 2.0 command-line interface.

	  tpm2sh is a command-line interface for interacting with TPM
	  2.0 chips directly through /dev/tpm0 or /dev/tpmrm0.

	  https://github.com/jarkkojs/tpm2-library

comment "tpm2sh needs a toolchain with Rust support"
	depends on !BR2_PACKAGE_HOST_RUSTC_TARGET_ARCH_SUPPORTS
```
